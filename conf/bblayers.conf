## conf/bblayers.conf
```bitbake
# LAYER_CONF_VERSION is increased each time build/conf/bblayers.conf
# changes incompatibly
LCONF_VERSION = "7"
TOPDIR := "${@os.path.dirname(os.path.dirname(d.getVar('FILE', True)))}"

BBPATH = "${TOPDIR}"

BBFILES = ""

# These layers hold recipe metadata not found in OE-core, but lack any machine or distro content
BASELAYERS ?= " \
  ${TOPDIR}/layers/meta-openembedded/meta-oe \
  ${TOPDIR}/layers/meta-openembedded/meta-initramfs \
  ${TOPDIR}/layers/meta-openembedded/meta-networking \
  ${TOPDIR}/layers/meta-openembedded/meta-webserver \
  ${TOPDIR}/layers/meta-openembedded/meta-filesystems \
  ${TOPDIR}/layers/meta-openembedded/meta-perl \
  ${TOPDIR}/layers/meta-openembedded/meta-python \
"

# These layers hold machine specific content, aka Board Support Packages
BSPLAYERS ?= " \
  ${TOPDIR}/layers/meta-beagleboard/common-bsp \
"

# Add your overlay location to EXTRALAYERS
# Make sure to have a conf/layers.conf in there
EXTRALAYERS ?= " \
  ${TOPDIR}/layers/meta-linaro/meta-linaro \
  ${TOPDIR}/layers/meta-linaro/meta-linaro-toolchain \
  ${TOPDIR}/layers/meta-ambertec/core \
  ${TOPDIR}/layers/meta-ambertec/bft \
  ${TOPDIR}/layers/meta-nodejs \
  ${TOPDIR}/layers/meta-nodejs-contrib \
  ${TOPDIR}/layers/meta-rslsync \
  ${TOPDIR}/layers/meta-micropython \
"

BBLAYERS = " \
  ${TOPDIR}/layers/meta-angstrom \
  ${TOPDIR}/layers/meta-aeos \
  ${BASELAYERS} \
  ${BSPLAYERS} \
  ${EXTRALAYERS} \
  ${TOPDIR}/layers/openembedded-core/meta \
"
```

## conf/local.conf
```bitbake
# CONF_VERSION is increased each time build/conf/ changes incompatibly
CONF_VERSION = "1"

INHERIT += "rm_work"

# Which files do we want to parse:
BBMASK = "(openjdk|qtbase|ti-cgt6x)"

# Build U-Boot initramfs images
IMAGE_CLASSES = "image_types_uboot"
IMAGE_TYPES = "cpio.gz.u-boot"
IMAGE_FSTYPES = "cpio.gz.u-boot"

# Disable ISO image by default
NOISO = "1"

# Avoid dragging in core-image-minimal-initramfs, which drags in grub which in turn fails to build
INITRD_IMAGE = "small-image"

# Make use of SMP:
#   PARALLEL_MAKE specifies how many concurrent compiler threads are spawned per bitbake process
#   BB_NUMBER_THREADS specifies how many concurrent bitbake tasks will be run
PARALLEL_MAKE     = "-j2"
BB_NUMBER_THREADS = "8"

VIRTUAL-RUNTIME_init_manager = "sysvinit"

DISTRO_FEATURES_append = " sysvinit"
DISTRO_FEATURES_BACKFILL = "sysvinit"
DISTRO_FEATURES_BACKFILL_CONSIDERED = "systemd"

# LINUX_LIBC_HEADERS_VERSION = "3.19%"

PREFERRED_PROVIDER_glibc = "glibc"
PREFERRED_PROVIDER_libevent = "libevent"
PREFERRED_PROVIDER_node = "iojs"
PREFERRED_PROVIDER_node-native = "iojs-native"

DISTRO = "angstrom-v2015.06"

# Set DEPLOY_DIR outside of TMPDIR

DEPLOY_DIR = "${TMPDIR}/../../deploy/${TCLIBC}"
# Don't generate the mirror tarball for SCM repos, the snapshot is enough
BB_GENERATE_MIRROR_TARBALLS = "0"

# Disable build time patch resolution. This would lauch a devshell
# and wait for manual intervention. We disable it.
PATCHRESOLVE = "noop"

#
# Parallelism Options
#
# These two options control how much parallelism BitBake should use. The first
# option determines how many tasks bitbake should run in parallel:
# Default to setting automatically based on cpu count
BB_NUMBER_THREADS ?= "${@oe.utils.cpu_count()}"
#
# The second option controls how many processes make should run in parallel when
# running compile tasks:
# Default to setting automatically based on cpu count
PARALLEL_MAKE ?= "-j ${@oe.utils.cpu_count()}"

#
# Shared-state files from other locations
#
# Shared state files are prebuilt cache data objects which can
# used to accelerate build time. This variable can be used to configure the system
# to search other mirror locations for these objects before it builds the data itself.
#
# This can be a filesystem directory, or a remote url such as http or ftp. These
# would contain the sstate-cache results from previous builds (possibly from other
# machines). This variable works like fetcher MIRRORS/PREMIRRORS and points to the
# cache locations to check for the shared objects.
#SSTATE_MIRRORS ?= "\
#file://.* http://someserver.tld/share/sstate/ \n \
#file://.* file:///some/local/dir/sstate/"

#SSTATE_MIRRORS ?= "\
#file://.* http://dominion.thruhere.net/angstrom/sstate-mirror/ \n "

# enable PR service on build machine itself
# its good for a case when this is the only builder
# generating the feeds
#
PRSERV_HOST = "localhost:0"
```
